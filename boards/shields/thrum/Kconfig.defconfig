## boards/shields/thrum/Kconfig.defconfig
```kconfig
if SHIELD_THRUM_LEFT

# Name must be less than 16 characters long!
config ZMK_KEYBOARD_NAME
    default "Thrum"

config ZMK_SPLIT_ROLE_CENTRAL
    default y

endif

if SHIELD_THRUM_LEFT || SHIELD_THRUM_RIGHT

config ZMK_SPLIT
    default y

endif
```

## boards/shields/thrum/Kconfig.shield
```kconfig
# No whitespace after the comma or in your part name!
config SHIELD_THRUM_LEFT
    def_bool $(shields_list_contains,thrum_left)

# No whitespace after the comma or in your part name!
config SHIELD_THRUM_RIGHT
    def_bool $(shields_list_contains,thrum_right)
```
